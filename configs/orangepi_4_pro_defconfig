## configs/orangepi_4_pro_defconfig
```kconfig
CONFIG_ARM=y
CONFIG_ARCH_SUNXI=y
CONFIG_DEFAULT_DEVICE_TREE="sun60i-a733-orangepi-4-pro"
CONFIG_SPL=y
CONFIG_DRAM_SUN60I_A733_PIN_SWIZZLE=y
CONFIG_MACH_SUN60I_A733=y
CONFIG_UART0_PORT_B0=y
CONFIG_MMC_SUNXI_SLOT_EXTRA=2
CONFIG_R_I2C_ENABLE=y
CONFIG_PCI=y
CONFIG_SPL_I2C=y
CONFIG_CMD_PCI=y
CONFIG_CMD_PMIC=y
CONFIG_CMD_REGULATOR=y
CONFIG_SYS_I2C_MVTWSI=y
CONFIG_SYS_I2C_SLAVE=0x7f
CONFIG_SYS_I2C_SPEED=400000
CONFIG_SUPPORT_EMMC_BOOT=y
CONFIG_NVME_PCI=y
CONFIG_PCIE_DW_SUNXI=y
CONFIG_PHY_SUN60I_COMBOPHY=y
CONFIG_REGULATOR_AXP=y
CONFIG_AXP_DCDC1_VOLT=3300
CONFIG_AXP_DCDC2_VOLT=800
CONFIG_AXP_DCDC3_VOLT=1050
CONFIG_AXP_DCDC4_VOLT=800
CONFIG_AXP_DCDC5_VOLT=1000
CONFIG_AXP_DCDC6_VOLT=560
CONFIG_AXP_DCDC7_VOLT=1080
CONFIG_AXP_BLDO1_VOLT=1800
CONFIG_AXP_BLDO2_VOLT=1800
CONFIG_AXP_BLDO4_VOLT=1800
CONFIG_AXP_DLDO1_VOLT=3300
CONFIG_AXP_ELDO1_VOLT=1075
CONFIG_USB_EHCI_HCD=y
CONFIG_USB_OHCI_HCD=y
```
